## CMakeLists.txt
```
cmake_minimum_required(VERSION 3.20.0)
find_package(Zephyr REQUIRED HINTS $ENV{ZEPHYR_BASE})

project(capbot_firmware)

include_directories(inc)
target_sources(app PRIVATE src/main.c src/capbot_board.c src/capbot_motor.c src/ble_rcs.c)
```

## west.yml
```
manifest:
  version: 0.13

  projects:
    # Nordic's nRF Connect SDK
    - name: nrf
      url: https://github.com/nrfconnect/sdk-nrf
      revision: v2.7.0
      import:
        file: west.yml
        path-prefix: deps
        name-allowlist:
          - cmsis
          - hal_nordic
          - nrfxlib
          - zephyr
    # Capbot's zephyr board definitions
    - name: capbot-zephyr-boards
      url: https://gitlab.kuleuven.be/distrinet/taskforces/nes/freebot/zephyr-boards
      revision: 86e6d1452a5991138f4eec008c8448edf00b211b
      path: deps/capbot/boards

  self:
    path: robot
```

## prj.conf
```kconfig
# Enable serial driver
CONFIG_SERIAL=y

# Enable console drivers
CONFIG_CONSOLE=y
CONFIG_UART_CONSOLE=y

# Enable logging
CONFIG_LOG=y

# Enable BLE
CONFIG_BT=y
CONFIG_BT_PERIPHERAL=y
CONFIG_BT_GATT_CACHING=n
```

## src/main.c
```c
/**
 * @file main.c
 * @author Lowie Deferme <lowie.deferme@kuleuven.be>
 * @brief Robot control via BLE GATT service
 */

#include <zephyr/bluetooth/bluetooth.h>
#include <zephyr/bluetooth/conn.h>
#include <zephyr/kernel.h>
#include <zephyr/logging/log.h>

#include "ble_rcs.h"
#include "capbot.h"

#define ROBOT_ID 9999

LOG_MODULE_REGISTER(main, LOG_LEVEL_DBG);

// -----------------------------------------------------------------------------
// Status led thread
//
// This thread makes the status leds blink in different patterns based on the
// current BLE status
// -----------------------------------------------------------------------------

/** @brief Enum to represent BLE status */
typedef enum ble_status_e {
    BLE_INACTIVE,
    BLE_ADVERTISING,
    BLE_CONNECTED,
    BLE_ERROR,
} ble_status_t;

/**
 * @brief Determine pattern mask for BLE status led
 *
 * @param status Status to get pattern for
 * @return uint16_t The pattern
 */
uint16_t ble_led_pattern(ble_status_t status) {
    switch (status) {
    case BLE_ADVERTISING:
        // Low frequency blink
        return 0b1111111100000000;
    case BLE_CONNECTED:
        // Off: save energy
        return 0b0000000000000000;
    case BLE_ERROR:
        // High frequency blink
        return 0b1010101010101010;
    case BLE_INACTIVE:
        // Long-long
        return 0b0011111100111111;
    default:
        LOG_WRN("Could not determine BLE status led pattern, using ERROR "
                "pattern instead");
        return ble_led_pattern(BLE_ERROR);
    }
}

// -----------------------------------------------------------------------------

/**
 * @brief Global static to hold BLE status.
 *
 * Always use `ble_status_get()` and `ble_status_set()` for accessing!
 */
static ble_status_t ble_status_g;

// BLE status info should be mutexed since it's shared between threads
K_MUTEX_DEFINE(ble_status_mutex);

/** @brief Get the current BLE status */
ble_status_t ble_status_get(void) {
    static ble_status_t clone = BLE_ERROR;
    if (k_mutex_lock(&ble_status_mutex, K_MSEC(5))) {
        LOG_WRN("Using old BLE status: could not lock mutex");
    } else {
        clone = ble_status_g;
        k_mutex_unlock(&ble_status_mutex);
    }
    return clone;
}

/** @brief Set the current BLE status */
void ble_status_set(ble_status_t status) {
    if (k_mutex_lock(&ble_status_mutex, K_MSEC(10))) {
        LOG_ERR("Failed to update BLE status: could not lock mutex");
    } else {
        ble_status_g = status;
        k_mutex_unlock(&ble_status_mutex);
    }
}

// -----------------------------------------------------------------------------

/** @brief Entry point of status led thread */
void t_status_led_ep(void *, void *, void *) {
    const cb_led_t status_led = CB_D15;
    uint16_t led_pattern = 0;
    uint8_t pattern_index = 0;

    for (;;) {
        // Get pattern based on current BLE status
        led_pattern = ble_led_pattern(ble_status_get());
        // Update led based on patters and index
        int err = cb_led_write(status_led, (led_pattern >> pattern_index) & 0b1);
        if (err)
            LOG_WRN("Error during BLE status led update");
        // Update index
        pattern_index = (pattern_index + 1) % (sizeof(led_pattern) * 8);
        // Sleep before next update => circa one pattern cycle per second
        k_sleep(K_MSEC(62));
    }
}

// Stack area for the status led thread
K_THREAD_STACK_DEFINE(t_status_led_stack, 256);

// Status led thead data
struct k_thread t_status_led_data;

// -----------------------------------------------------------------------------
// BLE connection management
// -----------------------------------------------------------------------------

#define BLE_DEVICE_NAME "CapBot"
#define BLE_DEVICE_NAME_LEN (sizeof(BLE_DEVICE_NAME) - 1)

/** @brief BLE Advertisement data */
static const struct bt_data adv_data[] = {
    BT_DATA_BYTES(BT_DATA_FLAGS, (BT_LE_AD_GENERAL | BT_LE_AD_NO_BREDR)),
};

/** @brief BLE Scan response data */
static const struct bt_data rsp_data[] = {
    BT_DATA(BT_DATA_NAME_COMPLETE, BLE_DEVICE_NAME, BLE_DEVICE_NAME_LEN),
    BT_DATA_BYTES(BT_DATA_UUID128_SOME, BT_UUID_RCS_VAL),
};

/** @brief Start BLE advertising */
int bt_advertise(void) {
    if (bt_le_adv_start(BT_LE_ADV_CONN, adv_data, ARRAY_SIZE(adv_data), rsp_data,
                        ARRAY_SIZE(rsp_data))) {
        LOG_ERR("BLE advertising failed to start");
        ble_status_set(BLE_ERROR);
        return -1;
    }
    ble_status_set(BLE_ADVERTISING);
    LOG_INF("BLE advertising started");
    return 0;
}

/** @brief On BLE connected callback */
static void bt_on_connected(struct bt_conn *conn, uint8_t err) {
    char addr[BT_ADDR_LE_STR_LEN];
    bt_addr_le_to_str(bt_conn_get_dst(conn), addr, sizeof(addr));

    if (err) {
        LOG_ERR("Failed to connect to %s (%u)", addr, err);
        return;
    }
    LOG_INF("Connected: %s", addr);

    ble_status_set(BLE_CONNECTED);
}

/** @brief On BLE disconnected callback */
static void bt_on_disconnected(struct bt_conn *conn, uint8_t reason) {
    char addr[BT_ADDR_LE_STR_LEN];
    bt_addr_le_to_str(bt_conn_get_dst(conn), addr, sizeof(addr));
    LOG_INF("Disconnected: %s (reason 0x%02x)", addr, reason);

    bt_advertise();
}

/** @brief BLE connection callbacks */
BT_CONN_CB_DEFINE(connection_cb) = {
    .connected = bt_on_connected,
    .disconnected = bt_on_disconnected,
};

// -----------------------------------------------------------------------------
// System initialization
// -----------------------------------------------------------------------------

int sys_init(void) {
    // Initialize CapBot library
    int cb_init_err = 0;
    cb_init_err |= cb_led_init();
    cb_init_err |= cb_btn_init();
    cb_init_err |= cb_measure_init();
    cb_init_err |= cb_motor_init();
    if (cb_init_err) {
        LOG_ERR("CapBot initialization failed");
        return -1;
    }
    LOG_INF("CapBot library initialization was successful");

    // Set RCS identifier
    rcs_set_id((uint32_t) ROBOT_ID);

    // Start status led thread
    ble_status_set(BLE_INACTIVE);
    k_thread_create(&t_status_led_data, t_status_led_stack,
                    K_THREAD_STACK_SIZEOF(t_status_led_stack), t_status_led_ep, NULL, NULL, NULL,
                    10, K_USER, K_NO_WAIT);

    // Initialize bluetooth
    if (bt_enable(NULL)) {
        LOG_ERR("Bluetooth initialization failed");
        ble_status_set(BLE_ERROR);
        return -1;
    }
    LOG_INF("Bluetooth initialization was successful");

    if (bt_advertise()) {
        return -1;
    }

    return 0;
}

SYS_INIT(sys_init, APPLICATION, 5);
```

## inc/ble_rcs.h
```c
/**
 * @file ble_rcs.h
 * @author Lowie Deferme <lowie.deferme@kuleuven.be>
 * @date 2025-01-02
 */

#ifndef RCS_H
#define RCS_H

#include <stdint.h>
#include <zephyr/bluetooth/uuid.h>

// -----------------------------------------------------------------------------
// Robot Control Service (RCS)
// -----------------------------------------------------------------------------

#define BT_UUID_RCS_VAL BT_UUID_128_ENCODE(0x00000030, 0x0000, 0x1000, 0x8000, 0x00805f9b34fb)
#define BT_UUID_RCS BT_UUID_DECLARE_128(BT_UUID_RCS_VAL)

// -----------------------------------------------------------------------------
// Motor drive characteristic
// -----------------------------------------------------------------------------

#define BT_UUID_RCS_DRIVE_VAL BT_UUID_128_ENCODE(0x00000031, 0x0000, 0x1000, 0x8000, 0x00805f9b34fb)
#define BT_UUID_RCS_DRIVE BT_UUID_DECLARE_128(BT_UUID_RCS_DRIVE_VAL)

/** @brief Data format for motor drive characteristic */
typedef struct {
    /** @brief Target speed (RPM) for front left motor */
    int8_t fl;
    /** @brief Target speed (RPM) for front right motor */
    int8_t fr;
    /** @brief Target speed (RPM) for back left motor */
    int8_t bl;
    /** @brief Target speed (RPM) for back right motor */
    int8_t br;
    /** @brief The amount of milliseconds to keep target speeds before stopping */
    uint32_t dur;
} rcs_drive_t;

// -----------------------------------------------------------------------------
// Motor speed characteristic
// -----------------------------------------------------------------------------

#define BT_UUID_RCS_SPEED_VAL BT_UUID_128_ENCODE(0x00000032, 0x0000, 0x1000, 0x8000, 0x00805f9b34fb)
#define BT_UUID_RCS_SPEED BT_UUID_DECLARE_128(BT_UUID_RCS_SPEED_VAL)

/** @brief Data format for motor speed characteristic */
typedef struct {
    /** @brief Measured speed (RPM) of front left motor */
    int8_t fl;
    /** @brief Measured speed (RPM) of front right motor */
    int8_t fr;
    /** @brief Measured speed (RPM) of back left motor */
    int8_t bl;
    /** @brief Measured speed (RPM) of back right motor */
    int8_t br;
} rcs_speed_t;

// -----------------------------------------------------------------------------
// Motor angle characteristic
// -----------------------------------------------------------------------------

#define BT_UUID_RCS_ANGLE_VAL BT_UUID_128_ENCODE(0x00000033, 0x0000, 0x1000, 0x8000, 0x00805f9b34fb)
#define BT_UUID_RCS_ANGLE BT_UUID_DECLARE_128(BT_UUID_RCS_ANGLE_VAL)

/** @brief Data format for motor angle characteristic */
typedef struct {
    /** @brief Measured angle (degrees) of front left motor */
    int32_t fl;
    /** @brief Measured angle (degrees) of front right motor */
    int32_t fr;
    /** @brief Measured angle (degrees) of back left motor */
    int32_t bl;
    /** @brief Measured angle (degrees) of back right motor */
    int32_t br;
} rcs_angle_t;

// -----------------------------------------------------------------------------
// Voltage measurement characteristic
// -----------------------------------------------------------------------------

#define BT_UUID_RCS_VOLT_VAL BT_UUID_128_ENCODE(0x00000034, 0x0000, 0x1000, 0x8000, 0x00805f9b34fb)
#define BT_UUID_RCS_VOLT BT_UUID_DECLARE_128(BT_UUID_RCS_VOLT_VAL)

/** @brief Data format for voltage measurement characteristic */
typedef struct {
    /** @brief Measured voltage (mV) */
    uint16_t volt;
} rcs_volt_t;

// -----------------------------------------------------------------------------
// Identifier characteristic
// -----------------------------------------------------------------------------

#define BT_UUID_RCS_ID_VAL BT_UUID_128_ENCODE(0x00000035, 0x0000, 0x1000, 0x8000, 0x00805f9b34fb)
#define BT_UUID_RCS_ID BT_UUID_DECLARE_128(BT_UUID_RCS_ID_VAL)

/** @brief Data format for identifier characteristic */
typedef struct {
    /** @brief Identifier */
    uint32_t id;
} rcs_id_t;

/** @brief Update identifier */
void rcs_set_id(uint32_t id);

#endif /* RCS_H */
```

## inc/capbot.h
```c
/**
 * @file capbot.h
 * @author Lowie Deferme <lowie.deferme@kuleuven.be>
 * @brief Convenience header for CapBot library
 * @date 2024-12-20
 */

#ifndef CAPBOT_H
#define CAPBOT_H

#include "capbot_board.h"
#include "capbot_error.h"
#include "capbot_motor.h"

#endif /* CAPBOT_H */
```

## inc/capbot_board.h
```c
/**
 * @file capbot_board.h
 * @author Lowie Deferme <lowie.deferme@kuleuven.be>
 * @brief CapBot library for on-board peripherals
 */

#ifndef CAPBOT_BOARD_H
#define CAPBOT_BOARD_H

#include <stdint.h>

// -----------------------------------------------------------------------------
// On-board LEDs
// -----------------------------------------------------------------------------

typedef enum {
    CB_D15,
    CB_D16,
} cb_led_t;

/** @brief Initialize robot's leds */
int cb_led_init(void);

/**
 * @brief Write to led
 *
 * @param led The led to write
 * @param val The value to write: 0 = off, 1 = on
 * @retval <0: An error occurred
 */
int cb_led_write(cb_led_t led, uint8_t val);

// -----------------------------------------------------------------------------
// On-board buttons
// -----------------------------------------------------------------------------

/** @brief Initialize robot's button */
int cb_btn_init(void);

/**
 * @brief Get button status
 *
 * @retval 0: the button isn't pressed
 * @retval 1: the button is pressed
 * @retval <0: An error occurred
 */
int cb_btn_get(void);

// -----------------------------------------------------------------------------
// On-board voltage measurements
// -----------------------------------------------------------------------------

/**
 * @brief Initialize robot's voltage measurement system
 *
 * @return int
 */
int cb_measure_init(void);

/**
 * @brief Measure supercapacitor voltage
 *
 * @retval ≥0: measured voltage in mV
 * @retval <0: An error occurred
 */
int16_t cb_measure_vcap(void);

#endif /* CAPBOT_BOARD_H */
```

## inc/capbot_error.h
```c
/**
 * @file capbot_error.h
 * @author Lowie Deferme <lowie.deferme@kuleuven.be>
 * @brief Error codes for CapBot library
 */

typedef enum {
    CB_E_LED_UNK = 1,
} cb_err_t;
```

## inc/capbot_motor.h
```c
/**
 * @file capbot_motor.h
 * @author Lowie Deferme <lowie.deferme@kuleuven.be>
 * @brief CapBot library for motor control
 */

#ifndef CAPBOT_MOTOR_H
#define CAPBOT_MOTOR_H

/** @brief Motor speeds (rpm) */
typedef struct {
    /** @brief Front left motor speed (rpm)*/
    int front_left;
    /** @brief Front right motor speed (rpm)*/
    int front_right;
    /** @brief Back left motor speed (rpm)*/
    int back_left;
    /** @brief Back right motor speed (rpm)*/
    int back_right;
} cb_motor_speed_t;

/** @brief Motor angle (degrees) */
typedef struct {
    /** @brief Front left motor angle (degrees)*/
    int front_left;
    /** @brief Front right motor angle (degrees)*/
    int front_right;
    /** @brief Back left motor angle (degrees)*/
    int back_left;
    /** @brief Back right motor angle (degrees)*/
    int back_right;
} cb_motor_angle_t;

/**
 * @brief Initialize motors
 * @details v1.0 equivalent: Motors_init(void)
 * @details v2.* equivalent: fb_motor_init(void)
 */
int cb_motor_init(void);

/**
 * @brief Set individual motor speeds
 * @param speeds struct with the new speeds
 */
void cb_set_motor_speed(cb_motor_speed_t *speeds);

/**
 * @brief Get motor speeds
 * @param speeds struct to populate with the new speeds
 */
void cb_get_motor_speed(cb_motor_speed_t *speeds);

/**
 * @brief Get motor angles
 * @param speeds struct to populate with the new angles
 */
void cb_get_motor_angle(cb_motor_angle_t *angles);

/** @brief Stop the robot */
void cb_stop(void);

#endif /* CAPBOT_MOTOR_H */
```

## src/ble_rcs.c
```c
/**
 * @file ble_rcs.c
 * @author Lowie Deferme <lowie.deferme@kuleuven.be>
 * @date 2025-01-02
 */

#include <zephyr/bluetooth/gatt.h>
#include <zephyr/logging/log.h>

#include "ble_rcs.h"
#include "capbot.h"

LOG_MODULE_REGISTER(robot_control_service, LOG_LEVEL_DBG);

// -----------------------------------------------------------------------------
// Motor drive characteristic
// -----------------------------------------------------------------------------

#define T_DRIVE_TIMEOUT_PRIORITY 7
K_THREAD_STACK_DEFINE(t_drive_timeout_stack, 512);
static struct k_thread t_drive_timeout;
static struct {
    cb_motor_speed_t speeds;
    k_timeout_t duration;
} t_drive_timeout_data;

void t_drive_timeout_ep(void *, void *, void *) {
    LOG_DBG("Setting motors: {%d, %d, %d, %d}", t_drive_timeout_data.speeds.front_left,
            t_drive_timeout_data.speeds.front_right, t_drive_timeout_data.speeds.back_left,
            t_drive_timeout_data.speeds.back_right);
    cb_set_motor_speed(&t_drive_timeout_data.speeds);
    LOG_DBG("Waiting for timeout");
    k_sleep(t_drive_timeout_data.duration);
    LOG_DBG("Timeout reached, stopping motors");
    cb_stop();
}

void drive_with_timeout(cb_motor_speed_t *speeds, k_timeout_t timeout) {
    static k_tid_t drive_tid = 0;
    if (drive_tid != 0) {
        LOG_DBG("Aborting previous drive thread");
        k_thread_abort(drive_tid);
    }
    LOG_DBG("Creating drive thread");
    t_drive_timeout_data.speeds.front_left = speeds->front_left;
    t_drive_timeout_data.speeds.front_right = speeds->front_right;
    t_drive_timeout_data.speeds.back_left = speeds->back_left;
    t_drive_timeout_data.speeds.back_right = speeds->back_right;
    t_drive_timeout_data.duration = timeout;
    drive_tid = k_thread_create(&t_drive_timeout, t_drive_timeout_stack,
                                K_THREAD_STACK_SIZEOF(t_drive_timeout_stack), t_drive_timeout_ep,
                                NULL, NULL, NULL, T_DRIVE_TIMEOUT_PRIORITY, 0, K_NO_WAIT);
}

static ssize_t rcs_drive(struct bt_conn *conn, const struct bt_gatt_attr *attr, const void *buf,
                         uint16_t len, uint16_t offset, uint8_t flags) {
    LOG_DBG("handle: %u, conn: %p", attr->handle, (void *)conn);

    if (len != sizeof(rcs_drive_t)) {
        LOG_WRN("Incorrect data length for drive attribute");
        return BT_GATT_ERR(BT_ATT_ERR_INVALID_ATTRIBUTE_LEN);
    }

    if (offset != 0) {
        LOG_WRN("Incorrect data offset for drive attribute");
        return BT_GATT_ERR(BT_ATT_ERR_INVALID_OFFSET);
    }

    rcs_drive_t pkt = *((rcs_drive_t *)buf);
    cb_motor_speed_t speeds = {
        .front_left = pkt.fl, .front_right = pkt.fr, .back_left = pkt.bl, .back_right = pkt.br};
    drive_with_timeout(&speeds, K_MSEC(pkt.dur));

    return len;
}

// -----------------------------------------------------------------------------
// Motor speed characteristic
// -----------------------------------------------------------------------------

static ssize_t rcs_speed_read(struct bt_conn *conn, const struct bt_gatt_attr *attr, void *buf,
                              uint16_t len, uint16_t offset) {
    LOG_DBG("handle: %u, conn: %p", attr->handle, (void *)conn);

    cb_motor_speed_t speeds;
    cb_get_motor_speed(&speeds);

    LOG_INF("Reporting motor speeds: {%d %d %d %d}", speeds.front_left, speeds.front_right,
            speeds.back_left, speeds.back_right);
    rcs_speed_t pkt = {.fl = speeds.front_left,
                       .fr = speeds.front_right,
                       .bl = speeds.back_left,
                       .br = speeds.back_right};
    return bt_gatt_attr_read(conn, attr, buf, len, offset, &pkt, sizeof(pkt));
}

// -----------------------------------------------------------------------------
// Motor angle characteristic
// -----------------------------------------------------------------------------

static ssize_t rcs_angle_read(struct bt_conn *conn, const struct bt_gatt_attr *attr, void *buf,
                              uint16_t len, uint16_t offset) {
    LOG_DBG("handle: %u, conn: %p", attr->handle, (void *)conn);

    cb_motor_angle_t angles;
    cb_get_motor_angle(&angles);

    LOG_INF("Reporting motor angles: {%d %d %d %d}", angles.front_left, angles.front_right,
            angles.back_left, angles.back_right);
    rcs_angle_t pkt = {.fl = angles.front_left,
                       .fr = angles.front_right,
                       .bl = angles.back_left,
                       .br = angles.back_right};
    return bt_gatt_attr_read(conn, attr, buf, len, offset, &pkt, sizeof(pkt));
}

// -----------------------------------------------------------------------------
// Voltage measurement characteristic
// -----------------------------------------------------------------------------

static ssize_t rcs_volt_read(struct bt_conn *conn, const struct bt_gatt_attr *attr, void *buf,
                             uint16_t len, uint16_t offset) {
    LOG_DBG("handle: %u, conn: %p", attr->handle, (void *)conn);

    int vcap = cb_measure_vcap();
    LOG_DBG("measured voltage: %u", vcap);

    rcs_volt_t pkt = {.volt = vcap};
    return bt_gatt_attr_read(conn, attr, buf, len, offset, &pkt, sizeof(pkt));
}

// -----------------------------------------------------------------------------
// Identifier characteristic
// -----------------------------------------------------------------------------

/** @brief Global identifier. Never update directly, always use rcs_set_id! */
static uint32_t identifier = 0xffffffff;

static ssize_t rcs_id_read(struct bt_conn *conn, const struct bt_gatt_attr *attr, void *buf,
                           uint16_t len, uint16_t offset) {
    LOG_DBG("handle: %u, conn: %p", attr->handle, (void *)conn);

    rcs_id_t pkt = {.id = identifier};
    return bt_gatt_attr_read(conn, attr, buf, len, offset, &pkt, sizeof(pkt));
}

void rcs_set_id(uint32_t id) {
    // FIXME: mutex this access
    identifier = id;
}

// -----------------------------------------------------------------------------
// Robot Control Service (RCS)
// -----------------------------------------------------------------------------

BT_GATT_SERVICE_DEFINE(
    // Robot Control Service
    rcs_svc, BT_GATT_PRIMARY_SERVICE(BT_UUID_RCS),
    // Motor drive characteristic
    BT_GATT_CHARACTERISTIC(BT_UUID_RCS_DRIVE, BT_GATT_CHRC_WRITE | BT_GATT_CHRC_WRITE_WITHOUT_RESP,
                           BT_GATT_PERM_WRITE, NULL, rcs_drive, NULL),
    // Motor speed characteristic
    BT_GATT_CHARACTERISTIC(BT_UUID_RCS_SPEED, BT_GATT_CHRC_READ, BT_GATT_PERM_READ, rcs_speed_read,
                           NULL, NULL),
    // Motor angle characteristic
    BT_GATT_CHARACTERISTIC(BT_UUID_RCS_ANGLE, BT_GATT_CHRC_READ, BT_GATT_PERM_READ, rcs_angle_read,
                           NULL, NULL),
    // Voltage measurement characteristic
    BT_GATT_CHARACTERISTIC(BT_UUID_RCS_VOLT, BT_GATT_CHRC_READ, BT_GATT_PERM_READ, rcs_volt_read,
                           NULL, NULL),
    // Identifier characteristic
    BT_GATT_CHARACTERISTIC(BT_UUID_RCS_ID, BT_GATT_CHRC_READ, BT_GATT_PERM_READ, rcs_id_read, NULL,
                           NULL));
```

## src/capbot_board.c
```c
/**
 * @file capbot.c
 * @author Lowie Deferme <lowie.deferme@kuleuven.be>
 * @brief CapBot library for on-board peripherals
 */

#include "capbot_board.h"
#include "capbot_error.h"

#include <zephyr/drivers/adc.h>
#include <zephyr/drivers/gpio.h>
#include <zephyr/kernel.h>

// -----------------------------------------------------------------------------
// On-board LEDs
// -----------------------------------------------------------------------------

static const struct gpio_dt_spec d15 = GPIO_DT_SPEC_GET(DT_ALIAS(d15), gpios);
static const struct gpio_dt_spec d16 = GPIO_DT_SPEC_GET(DT_ALIAS(d16), gpios);

/**
 * @brief Private function to get a led's device tree struct based on it's id
 */
const struct gpio_dt_spec *cb_led_from_id(cb_led_t led) {
    switch (led) {
    case CB_D15:
        return &d15;
    case CB_D16:
        return &d16;
    default:
        return NULL;
    }
}

int cb_led_init(void) {
    int err = 0;

    if (gpio_is_ready_dt(&d15)) {
        err |= gpio_pin_configure_dt(&d15, GPIO_OUTPUT | GPIO_INPUT);
        err |= gpio_pin_set_dt(&d15, 0);
    } else {
        err = -1;
    }

    if (gpio_is_ready_dt(&d16)) {
        err |= gpio_pin_configure_dt(&d16, GPIO_OUTPUT | GPIO_INPUT);
        err |= gpio_pin_set_dt(&d16, 0);
    } else {
        err = -1;
    }

    return err;
}

int cb_led_write(cb_led_t led, uint8_t val) {
    const struct gpio_dt_spec *led_dt = cb_led_from_id(led);
    if (led_dt == NULL) {
        return -CB_E_LED_UNK;
    }
    return gpio_pin_set_dt(led_dt, val);
}

// -----------------------------------------------------------------------------
// On-board buttons
// -----------------------------------------------------------------------------

static const struct gpio_dt_spec sw2 = GPIO_DT_SPEC_GET(DT_ALIAS(sw2), gpios);

int cb_btn_init(void) {
    int err = 0;
    if (gpio_is_ready_dt(&sw2)) {
        err |= gpio_pin_configure_dt(&sw2, GPIO_INPUT);
    } else {
        err = 1;
    }

    return err;
}

int cb_btn_get(void) { return gpio_pin_get_dt(&sw2); }

// -----------------------------------------------------------------------------
// On-board voltage measurements
// -----------------------------------------------------------------------------

static const struct adc_dt_spec v_measure = ADC_DT_SPEC_GET(DT_PATH(zephyr_user));
static const struct gpio_dt_spec measure_en_vin =
    GPIO_DT_SPEC_GET_BY_IDX(DT_PATH(zephyr_user), measure_en_gpios, 0);
static const struct gpio_dt_spec measure_en_vcap =
    GPIO_DT_SPEC_GET_BY_IDX(DT_PATH(zephyr_user), measure_en_gpios, 1);
static const struct gpio_dt_spec measure_en_vmotor =
    GPIO_DT_SPEC_GET_BY_IDX(DT_PATH(zephyr_user), measure_en_gpios, 2);

/** @brief Private function to select Vcap as input for the ADC */
int cb_measure_sel_vcap(void) {
    int err = 0;
    if (!gpio_pin_get_dt(&measure_en_vcap)) {
        err |= gpio_pin_set_dt(&measure_en_vin, 0);
        err |= gpio_pin_set_dt(&measure_en_vcap, 1);
        err |= gpio_pin_set_dt(&measure_en_vmotor, 0);
        k_sleep(K_MSEC(5));
    }
    return err;
}

int cb_measure_init(void) {
    int err = 0;

    if (adc_is_ready_dt(&v_measure)) {
        err |= adc_channel_setup_dt(&v_measure);
    } else {
        return 1;
    }

    if (gpio_is_ready_dt(&measure_en_vin)) {
        err |= gpio_pin_configure_dt(&measure_en_vin, GPIO_OUTPUT);
        err |= gpio_pin_set_dt(&measure_en_vin, 0);
    } else {
        err = 1;
    }

    if (gpio_is_ready_dt(&measure_en_vcap)) {
        err |= gpio_pin_configure_dt(&measure_en_vcap, GPIO_OUTPUT);
        err |= gpio_pin_set_dt(&measure_en_vcap, 0);
    } else {
        err = 1;
    }

    if (gpio_is_ready_dt(&measure_en_vmotor)) {
        err |= gpio_pin_configure_dt(&measure_en_vmotor, GPIO_OUTPUT);
        err |= gpio_pin_set_dt(&measure_en_vmotor, 0);
    } else {
        err = 1;
    }

    return 0;
}

int16_t cb_measure_vcap(void) {
    uint32_t buf = 0;
    struct adc_sequence sequence = {
        .buffer = &buf,
        .buffer_size = sizeof(buf),
    };

    int err = cb_measure_sel_vcap();
    err |= adc_sequence_init_dt(&v_measure, &sequence);
    err |= adc_read_dt(&v_measure, &sequence);
    err |= adc_raw_to_millivolts_dt(&v_measure, &buf);

    if (err) {
        return -1;
    }

    return (int16_t)buf * 40;
    ;
}
```

## src/capbot_motor.c
```c
/**
 * @file capbot_motor.c
 * @author Lowie Deferme <lowie.deferme@kuleuven.be>
 * @brief CapBot motor control
 * @date 2024-12-23
 */

#include <zephyr/drivers/gpio.h>
#include <zephyr/drivers/pwm.h>
#include <zephyr/kernel.h>

#include <stdbool.h>

#include "capbot_motor.h"

#define PWM_PERIOD 20000000 /** ns */

#define DEGREES_PER_REVOLUTION 360
#define HALL_TICKS_PER_REVOLUTION 1380

/** @brief Time delta over which motor RPM is calculated */
K_MUTEX_DEFINE(motor_timing_mutex);
#define T_RPM_UPDATE_DELTA K_MSEC(20)

// -----------------------------------------------------------------------------
// Static objects for motors
// -----------------------------------------------------------------------------

/** @brief Holds a motor's GPIO handles */
struct motor_gpio {
    const struct pwm_dt_spec in_a;
    const struct pwm_dt_spec in_b;
    const struct gpio_dt_spec hall_c1;
    const struct gpio_dt_spec hall_c2;
};

/** @brief Wraps everything related to one motor together*/
struct motor {
    /** @brief Motor's IO handles */
    const struct motor_gpio *gpio;
    /**  @brief Callback info for motor's hall interrupt */
    struct gpio_callback hall_cb_data;
    /** @brief To keep track of a motor's steps: counts up/down every hall interrupt */
    int64_t step_count;
    /** @brief Step count at last calculation */
    int64_t step_prev;
    /** @brief Step count delta at last calculation */
    int64_t step_delta;
    /** @brief Time at last calculation */
    uint64_t time_prev;
    /** @brief Time delta at last calculation */
    uint64_t time_delta;
};

// -----------------------------------------------------------------------------

static const struct motor_gpio mfr_io = {
    .in_a = PWM_DT_SPEC_GET_BY_IDX(DT_ALIAS(mfr), 0),
    .in_b = PWM_DT_SPEC_GET_BY_IDX(DT_ALIAS(mfr), 1),
    .hall_c1 = GPIO_DT_SPEC_GET_BY_IDX(DT_ALIAS(mfr), hall_gpios, 0),
    .hall_c2 = GPIO_DT_SPEC_GET_BY_IDX(DT_ALIAS(mfr), hall_gpios, 1),
};

static struct motor mfr = {
    .gpio = &mfr_io,
    .step_count = 0,
    .step_prev = 0,
    .step_delta = 0,
    .time_prev = 0,
    .time_delta = 0,
};

static const struct motor_gpio mfl_io = {
    .in_a = PWM_DT_SPEC_GET_BY_IDX(DT_ALIAS(mfl), 0),
    .in_b = PWM_DT_SPEC_GET_BY_IDX(DT_ALIAS(mfl), 1),
    .hall_c1 = GPIO_DT_SPEC_GET_BY_IDX(DT_ALIAS(mfl), hall_gpios, 0),
    .hall_c2 = GPIO_DT_SPEC_GET_BY_IDX(DT_ALIAS(mfl), hall_gpios, 1),
};

static struct motor mfl = {
    .gpio = &mfl_io,
    .step_count = 0,
    .step_prev = 0,
    .step_delta = 0,
    .time_prev = 0,
    .time_delta = 0,
};

static const struct motor_gpio mbr_io = {
    .in_a = PWM_DT_SPEC_GET_BY_IDX(DT_ALIAS(mbr), 0),
    .in_b = PWM_DT_SPEC_GET_BY_IDX(DT_ALIAS(mbr), 1),
    .hall_c1 = GPIO_DT_SPEC_GET_BY_IDX(DT_ALIAS(mbr), hall_gpios, 0),
    .hall_c2 = GPIO_DT_SPEC_GET_BY_IDX(DT_ALIAS(mbr), hall_gpios, 1),
};

static struct motor mbr = {
    .gpio = &mbr_io,
    .step_count = 0,
    .step_prev = 0,
    .step_delta = 0,
    .time_prev = 0,
    .time_delta = 0,
};

static const struct motor_gpio mbl_io = {
    .in_a = PWM_DT_SPEC_GET_BY_IDX(DT_ALIAS(mbl), 0),
    .in_b = PWM_DT_SPEC_GET_BY_IDX(DT_ALIAS(mbl), 1),
    .hall_c1 = GPIO_DT_SPEC_GET_BY_IDX(DT_ALIAS(mbl), hall_gpios, 0),
    .hall_c2 = GPIO_DT_SPEC_GET_BY_IDX(DT_ALIAS(mbl), hall_gpios, 1),
};

static struct motor mbl = {
    .gpio = &mbl_io,
    .step_count = 0,
    .step_prev = 0,
    .step_delta = 0,
    .time_prev = 0,
    .time_delta = 0,
};

// -----------------------------------------------------------------------------
// Motor control: private functions
// -----------------------------------------------------------------------------

/**
 * @brief Initialize a motor's IO
 *
 * @param motor The motor
 * @param hall_isr Callback for motor's hall interrupt
 * @retval <0: An error occurred
 */
static int init_motor_io(struct motor *motor, gpio_callback_handler_t hall_isr) {
    int err = 0;

    err |= !pwm_is_ready_dt(&motor->gpio->in_a);
    err |= !pwm_is_ready_dt(&motor->gpio->in_b);

    if (err) {
        return err;
    }

    err |= !gpio_is_ready_dt(&motor->gpio->hall_c1);
    err |= !gpio_is_ready_dt(&motor->gpio->hall_c2);

    if (err) {
        return err;
    }

    err |= gpio_pin_configure_dt(&motor->gpio->hall_c1, GPIO_INPUT);
    err |= gpio_pin_configure_dt(&motor->gpio->hall_c2, GPIO_INPUT);

    if (err) {
        return err;
    }

    gpio_init_callback(&motor->hall_cb_data, hall_isr, BIT(motor->gpio->hall_c2.pin));
    err |= gpio_pin_interrupt_configure_dt(&motor->gpio->hall_c2, GPIO_INT_EDGE_BOTH);
    err |= gpio_add_callback_dt(&motor->gpio->hall_c2, &motor->hall_cb_data);

    return err;
}

/**
 * @brief Put a PWM signal on a motor's pins
 *
 * @param motor Pointer to motor's wrapper struct
 * @param direction Direction to turn (`1` = forwards, `0` = backwards)
 * @param pulse_width The width of the PWM pulse
 */
static inline void set_motor_pwm(const struct motor *motor, bool direction, uint32_t pulse_width) {
    pwm_set_dt(&(motor->gpio->in_a), PWM_PERIOD, 0);
    pwm_set_dt(&(motor->gpio->in_b), PWM_PERIOD, 0);
}

/** @brief Stop a given motor */
static inline void set_motor_stop(const struct motor *motor) {
    pwm_set_dt(&(motor->gpio->in_a), PWM_PERIOD, 0);
    pwm_set_dt(&(motor->gpio->in_b), PWM_PERIOD, 0);
}

/** @brief Update motor timing info */
static inline void update_motor_timing(struct motor *motor, uint64_t time_curr) {
    if (k_mutex_lock(&motor_timing_mutex, K_FOREVER) == 0) {
        motor->step_delta = motor->step_count - motor->step_prev;
        motor->step_prev = motor->step_count;
        motor->time_delta = time_curr - motor->time_prev;
        motor->time_prev = time_curr;
        k_mutex_unlock(&motor_timing_mutex);
    }
}

/** @brief Get motor's angle in degrees */
static inline int get_motor_angle(struct motor *motor) {
    return motor->step_count * DEGREES_PER_REVOLUTION / HALL_TICKS_PER_REVOLUTION;
}

/** @brief Get motor's speed in RPM */
static inline int get_motor_rpm(struct motor *motor) {
    if (k_mutex_lock(&motor_timing_mutex, T_RPM_UPDATE_DELTA)) {
        // Error: could not lock mutex
        return -1;
    }
    int64_t step_d = motor->step_delta;
    uint64_t time_d = motor->time_delta;
    k_mutex_unlock(&motor_timing_mutex);

    return (step_d * 60000) / (int64_t)k_ticks_to_ms_near64(time_d * HALL_TICKS_PER_REVOLUTION);
}

// -----------------------------------------------------------------------------
// Hall sensor interrupts
// -----------------------------------------------------------------------------

/** @brief Generic hall sensor interrupt handler (called by motor specific ones) */
static inline void hall_isr(struct motor *motor) {
    int c1 = gpio_pin_get_dt(&motor->gpio->hall_c1);
    int c2 = gpio_pin_get_dt(&motor->gpio->hall_c2);

    if (c1 == c2) {
        motor->step_count++;
    } else {
        motor->step_count--;
    }
}

void mfr_isr(const struct device *dev, struct gpio_callback *cb, uint32_t pins) { hall_isr(&mfr); }
void mfl_isr(const struct device *dev, struct gpio_callback *cb, uint32_t pins) { hall_isr(&mfl); }
void mbr_isr(const struct device *dev, struct gpio_callback *cb, uint32_t pins) { hall_isr(&mbr); }
void mbl_isr(const struct device *dev, struct gpio_callback *cb, uint32_t pins) { hall_isr(&mbl); }

// -----------------------------------------------------------------------------
// RPM calculation thread
// -----------------------------------------------------------------------------

#define T_RPM_STACKSIZE 256
#define T_RPM_PRIORITY 7
#define T_RPM_OPTIONS 0

/**
 * @brief Periodically update timing info for calculating (average) motor
 * speeds
 */
void t_rpm_entry_point(void *, void *, void *) {
    for (;;) {
        update_motor_timing(&mfr, k_uptime_ticks());
        update_motor_timing(&mfl, k_uptime_ticks());
        update_motor_timing(&mbr, k_uptime_ticks());
        update_motor_timing(&mbl, k_uptime_ticks());

        k_sleep(T_RPM_UPDATE_DELTA);
    }
}

// Stack area for RPM calculation thread
K_THREAD_STACK_DEFINE(t_rpm_stack, T_RPM_STACKSIZE);

/** @brief Data for RPM calculation thread */
struct k_thread t_rpm_data;

// -----------------------------------------------------------------------------
// Motor control: API (public functions)
// -----------------------------------------------------------------------------

int cb_motor_init(void) {
    int err = 0;

    // Initialize front left motor
    err = init_motor_io(&mfl, mfl_isr);
    if (err) {
        return err;
    }
    set_motor_stop(&mfl);

    // Initialize front right motor
    err = init_motor_io(&mfr, mfr_isr);
    if (err) {
        return err;
    }
    set_motor_stop(&mfr);

    // Initialize back left motor
    err = init_motor_io(&mbl, mbl_isr);
    if (err) {
        return err;
    }
    set_motor_stop(&mbl);

    // Initialize back right motor
    err = init_motor_io(&mbr, mbr_isr);
    if (err) {
        return err;
    }
    set_motor_stop(&mbr);

    // Start motor timing thread
    k_thread_create(&t_rpm_data, t_rpm_stack, T_RPM_STACKSIZE, t_rpm_entry_point, NULL, NULL, NULL,
                    T_RPM_PRIORITY, T_RPM_OPTIONS, K_NO_WAIT);

    return 0;
}

void cb_set_motor_speed(cb_motor_speed_t *speeds) {
    set_motor_pwm(&mfl, 0, 0);
    set_motor_pwm(&mfr, 0, 0);
    set_motor_pwm(&mbl, 0, 0);
    set_motor_pwm(&mbr, 0, 0);
}

void cb_stop(void) {
    set_motor_stop(&mfl);
    set_motor_stop(&mfr);
    set_motor_stop(&mbl);
    set_motor_stop(&mbr);
}

void cb_get_motor_angle(cb_motor_angle_t *angles) {
    angles->front_left = get_motor_angle(&mfl);
    angles->front_right = get_motor_angle(&mfr);
    angles->back_left = get_motor_angle(&mbl);
    angles->back_right = get_motor_angle(&mbr);
}

void cb_get_motor_speed(cb_motor_speed_t *speeds) {
    speeds->front_left = get_motor_rpm(&mfl);
    speeds->front_right = get_motor_rpm(&mfr);
    speeds->back_left = get_motor_rpm(&mbl);
    speeds->back_right = get_motor_rpm(&mbr);
}
```
